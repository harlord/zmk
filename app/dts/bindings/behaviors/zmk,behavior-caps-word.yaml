## app/dts/bindings/behaviors/zmk,behavior-caps-word.yaml
```yaml
# Copyright (c) 2021 The ZMK Contributors
# SPDX-License-Identifier: MIT

description: Caps word behavior

compatible: "zmk,behavior-caps-word"

include: zero_param.yaml

properties:
  continue-list:
    type: array
    required: true
  mods:
    type: int
  expire-idle-ms:
    type: int
    default: 0
    description: The number of milliseconds to wait before the caps word is deactivated if no keys are pressed.
```
